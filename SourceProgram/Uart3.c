#include "Uart3.H"
#include "wifi.h"
/**********************宏定义******************************/
#define T2R     0x10              //AUXR.4	  定时器T2运行控制位
#define S1ST2   0x01              //AUXR.0	  选择定时器T2作为串口2波特率发生器
#define ET2   0x04				        //TE2.2   定时器T2中断允许位

#define S3SM0   0x00              //S3CON.7  串行口3工作方式为8位UART，波特率可变
//#define S3SM0   0x80              //S3CON.7  串行口3工作方式为9位UART，波特率可变
#define S3ST3   0x00              //S3CON.6  串行口3选择定时器2作为其波特率发生器
//#define S3ST3   0x40              //S3CON.6  串行口3选择定时器3作为其波特率发生器
#define S3REN   0x10              //S3CON.4  允许/禁止串行口3接收控制位
#define S3TI    0x02              //S3CON.1  发送中断请求中断标志位
#define S3RI    0x01              //S3CON.0  接收中断请求中断标志位

#define ES3     0x08              //IE2.3    串行口3中断允许位
#define S3_S	0x00			          //P_SW2.1  外围设备切换控制器2     串口3在P0.0/RXD3   P0.1/TXD3
//#define S3_S	0x02			          //P_SW2.1  外围设备切换控制器2     串口3在P5.0/RXD3_2   P5.1/TXD3_2

/*********************变量定义****************************/
uchar Uart3_Receive_i = 0;				//定义串行口3接收数据变量且赋值为0
bit Uart3_Receive_Flag = 0;				//定义串行口3接收数据完成标志位变量且赋值为0
bit B_TX3_Busy; 						      //发送忙标志
/****************************************************************************************************
/*函数：void Uart3_Init(void)			   //@11.0592MHz
/*功能：串行口3使用定时器T2作为波特率发生器初始化函数
/*说明：
/*修改日期：2021-02-23
/*作者：华南理工大学广州学院电工电子创新实验室——叶成彬  
/****************************************************************************************************/
void Uart3_Init(void)
{
	P_SW2 &= S3_S;			   //串口3在P0.0/RXD3   P0.1/TXD3
  S3CON = 0x00;								  					
	S3CON |= S3SM0;        //S3CON.7  串行口3工作方式为8位UART，波特率可变
	S3CON |= S3ST3;        //S3CON.6  串行口3选择定时器T2作为其波特率发生器
	T2L = 0xE8;		
	T2H = 0xFF;			       //设定定时初值，波特率9600
	AUXR &= 0xFB;		       //定时器T2时钟为Fosc/12,即12T
	AUXR |= S1ST2;		     //串行口3选择定时器2为波特率发生器
	AUXR |= T2R;		       //启动定时器T2
	IE2 &= ~ET2;		       //禁止定时器T2中断

	IE2  |=	ES3;		       //IE2.3    串行口3中断允许位
	S3CON &= ~S3REN;	     //S3CON.4  禁止串行口3接收控制位
	S3CON |= S3REN;		     //S3CON.4  允许串行口3接收控制位
	S3CON &= ~S3RI;		     //S3CON.0  清除接收中断请求中断标志位

  EA = 1;				         //开启单片机总中断
}

/****************************************************************************************************
/*函数：void Uart3_SendData(uchar dat)			   //@11.0592MHz
/*功能：串行口3发送数据函数
/*说明：
/*修改日期：2017-01-05
/*作者：华南理工大学广州学院电工电子创新实验室——叶成彬  
/****************************************************************************************************/
void Uart3_SendData(uchar dat)
{
	B_TX3_Busy = 1;
  S3BUF = dat;            //写数据到UART数据寄存器
	while(B_TX3_Busy);			//等待数据发送结束
}

/****************************************************************************************************
/*函数：void Uart3_SendString(uchar *s)	   //@11.0592MHz
/*功能：串行口3发送字符串函数
/*说明：
/*修改日期：2017-01-05
/*作者：华南理工大学广州学院电工电子创新实验室——叶成彬  
/****************************************************************************************************/
void Uart3_SendString(uchar *s)
{
    while(*s)                  //检测字符串结束标志
    {
      Uart3_SendData(*s++);         //发送当前字符
    }
}
/****************************************************************************************************
/*函数：void Uart3_Receive() interrupt 17		   //@11.0592MHz
/*功能：串行口3接收收据中断服务函数
/*说明：
/*修改日期：2021-02-26
/*作者：华南理工大学广州学院电工电子创新实验室——陈凌峰
/****************************************************************************************************/
void Uart3_Receive() interrupt 17
{
    if (S3CON & S3RI)					    							//判断是否接收到数据
    {
      S3CON &= ~S3RI;	            							//清除S3RI
		  Uart3_Receive_i = S3BUF;									//变量Uart3_Receive_i存储串行口3缓冲器S3BUF数据
		  Uart3_Receive_Flag = 1;		  							//串行口3接收到完整的数据标志位置1	
			uart_receive_input(Uart3_Receive_i);			//WIFI模块串口接收数据暂存处理
	}

	if( S3CON & S3TI )					    							//判断数据是否发送完成
    {
 		  S3CON &= ~S3TI;         	  							//清除S3TI位
      B_TX3_Busy = 0;
    }					
}
